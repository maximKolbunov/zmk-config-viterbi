## config/boards/shields/viterbi/Kconfig.defconfig
```kconfig
if SHIELD_VITERBI_LEFT

    config ZMK_KEYBOARD_NAME
        default "Viterbi"

    config ZMK_SPLIT_BLE_ROLE_CENTRAL
        default y

endif

if SHIELD_VITERBI_LEFT || SHIELD_VITERBI_RIGHT

    config ZMK_SPLIT
        default y

endif
```

## config/boards/shields/viterbi/Kconfig.shield
```kconfig
config SHIELD_VITERBI_LEFT
    def_bool $(shields_list_contains,viterbi_left)

config SHIELD_VITERBI_RIGHT
    def_bool $(shields_list_contains,viterbi_right)
```
